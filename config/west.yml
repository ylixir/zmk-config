## config/west.yml
```yaml
manifest:
  remotes:
    - name: zmkfirmware
      url-base: https://github.com/zmkfirmware
    - name: split-fix
      url-base: https://github.com/infused-kim
  projects:
#    - name: zmk
#      remote: zmkfirmware
#      revision: main
#      import: app/west.yml
    - name: zmk
      remote: split-fix
      revision: my-changes/split-encoder
      import: app/west.yml
  self:
    path: config
```
